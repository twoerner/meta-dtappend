## conf/layer.conf
```bitbake
# We have a conf and classes directory, add to BBPATH
BBPATH .= ":${LAYERDIR}"

# We have recipes-* directories, add to BBFILES
BBFILES += "${LAYERDIR}/recipes-*/*/*.bb \
            ${LAYERDIR}/recipes-*/*/*.bbappend"

BBFILE_COLLECTIONS += "meta-dtappend"
BBFILE_PATTERN_meta-dtappend = "^${LAYERDIR}/"
BBFILE_PRIORITY_meta-dtappend = "6"

LAYERDEPENDS_meta-dtappend = "core"
LAYERSERIES_COMPAT_meta-dtappend = "styhead walnascar"
```
